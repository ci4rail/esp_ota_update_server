## Kconfig
```kconfig
menu "OTA Update Server"

    choice INTERFACE_TYPE
        prompt "Interface Type"
        default OTA_CDC_ECM
        help
            Select via which interface type the ota update shall be performed.

        config OTA_CDC_ECM
            bool "CDC-ECM Interface"
        
        config OTA_ETHERNET
            bool "Ethernet"
    
    endchoice # INTERFACE_TYPE

    menu "Ethernet Configuration"
        depends on OTA_ETHERNET

        config USE_SPI_ETHERNET
            bool

        config CONTROL_PHY_POWER
            bool "Control PHY Power"
        help
            Control PHY power via GPIO.
        
        if CONTROL_PHY_POWER
            config PIN_PHY_POWER
                int "PHY Power Pin Number"
            help
                Select GPIO for controlling PHY power.
        endif # CONTROL_PHY_POWER

        choice ETHERNET_TYPE
            prompt "Ethernet Type"
            default USE_INTERNAL_ETHERNET if IDF_TARGET_ESP32
            default USE_W5500
            help
                Select which kind of Ethernet will be used in the example.

            config USE_INTERNAL_ETHERNET
                depends on IDF_TARGET_ESP32
                select ETH_USE_ESP32_EMAC
                bool "Internal EMAC"
                help
                    Select internal Ethernet MAC controller.

            config USE_DM9051
                bool "DM9051 Module"
                select USE_SPI_ETHERNET
                select ETH_USE_SPI_ETHERNET
                select ETH_SPI_ETHERNET_DM9051
                help
                    Select external SPI-Ethernet module (DM9051).

            config USE_W5500
                bool "W5500 Module"
                select USE_SPI_ETHERNET
                select ETH_USE_SPI_ETHERNET
                select ETH_SPI_ETHERNET_W5500
                help
                    Select external SPI-Ethernet module (W5500).

            config USE_KSZ8851SNL
                bool "KSZ8851SNL Module"
                select USE_SPI_ETHERNET
                select ETH_USE_SPI_ETHERNET
                select ETH_SPI_ETHERNET_KSZ8851SNL
                help
                    Select external SPI-Ethernet module (KSZ8851SNL).
        endchoice # ETHERNET_TYPE

        if USE_INTERNAL_ETHERNET
            choice ETH_PHY_MODEL
                prompt "Ethernet PHY Device"
                default ETH_PHY_IP101
                help
                    Select the Ethernet PHY device to use in the example.

                config ETH_PHY_IP101
                    bool "IP101"
                    help
                        IP101 is a single port 10/100 MII/RMII/TP/Fiber Fast Ethernet Transceiver.
                        Goto http://www.icplus.com.tw/pp-IP101G.html for more information about it.

                config ETH_PHY_RTL8201
                    bool "RTL8201/SR8201"
                    help
                        RTL8201F/SR8201F is a single port 10/100Mb Ethernet Transceiver with auto MDIX.
                        Goto http://www.corechip-sz.com/productsview.asp?id=22 for more information about it.

                config ETH_PHY_LAN8720
                    bool "LAN8720"
                    help
                        LAN8720A is a small footprint RMII 10/100 Ethernet Transceiver with HP Auto-MDIX Support.
                        Goto https://www.microchip.com/LAN8720A for more information about it.

                config ETH_PHY_DP83848
                    bool "DP83848"
                    help
                        DP83848 is a single port 10/100Mb/s Ethernet Physical Layer Transceiver.
                        Goto http://www.ti.com/product/DP83848J for more information about it.

                config ETH_PHY_KSZ8041
                    bool "KSZ8041"
                    help
                        The KSZ8041 is a single supply 10Base-T/100Base-TX Physical Layer Transceiver.
                        Goto https://www.microchip.com/wwwproducts/en/KSZ8041 for more information about it.

                config ETH_PHY_KSZ8081
                    bool "KSZ8081"
                    help
                        The KSZ8081 is a single supply 10Base-T/100Base-TX Physical Layer Transceiver.
                        Goto https://www.microchip.com/wwwproducts/en/KSZ8081 for more information about it.
            endchoice # ETH_PHY_MODEL

            config ETH_MDC_GPIO
                int "SMI MDC GPIO number"
                default 23
                help
                    Set the GPIO number used by SMI MDC.

            config ETH_MDIO_GPIO
                int "SMI MDIO GPIO number"
                default 18
                help
                    Set the GPIO number used by SMI MDIO.
        endif # USE_INTERNAL_ETHERNET

        if USE_SPI_ETHERNET
            config ETH_SPI_HOST
                int "SPI Host Number"
                range 0 2
                default 1
                help
                    Set the SPI host used to communicate with the SPI Ethernet Controller.

            config ETH_SPI_SCLK_GPIO
                int "SPI SCLK GPIO number"
                range 0 34 if IDF_TARGET_ESP32
                range 0 46 if IDF_TARGET_ESP32S2
                range 0 19 if IDF_TARGET_ESP32C3
                default 18 if IDF_TARGET_ESP32
                default 20 if IDF_TARGET_ESP32S2
                default 6 if IDF_TARGET_ESP32C3
                help
                    Set the GPIO number used by SPI SCLK.

            config ETH_SPI_MOSI_GPIO
                int "SPI MOSI GPIO number"
                range 0 34 if IDF_TARGET_ESP32
                range 0 46 if IDF_TARGET_ESP32S2
                range 0 19 if IDF_TARGET_ESP32C3
                default 23 if IDF_TARGET_ESP32
                default 19 if IDF_TARGET_ESP32S2
                default 7 if IDF_TARGET_ESP32C3
                help
                    Set the GPIO number used by SPI MOSI.

            config ETH_SPI_MISO_GPIO
                int "SPI MISO GPIO number"
                range 0 34 if IDF_TARGET_ESP32
                range 0 46 if IDF_TARGET_ESP32S2
                range 0 19 if IDF_TARGET_ESP32C3
                default 19 if IDF_TARGET_ESP32
                default 18 if IDF_TARGET_ESP32S2
                default 2 if IDF_TARGET_ESP32C3
                help
                    Set the GPIO number used by SPI MISO.

            config ETH_SPI_CS_GPIO
                int "SPI CS GPIO number"
                range 0 34 if IDF_TARGET_ESP32
                range 0 46 if IDF_TARGET_ESP32S2
                range 0 19 if IDF_TARGET_ESP32C3
                default 5 if IDF_TARGET_ESP32
                default 21 if IDF_TARGET_ESP32S2
                default 10 if IDF_TARGET_ESP32C3
                help
                    Set the GPIO number used by SPI CS.

            config ETH_SPI_CLOCK_MHZ
                int "SPI clock speed (MHz)"
                range 5 80
                default 12 if IDF_TARGET_ESP32 || IDF_TARGET_ESP32C3
                default 36 if IDF_TARGET_ESP32S2
                help
                    Set the clock speed (MHz) of SPI interface.

            config ETH_SPI_INT_GPIO
                int "Interrupt GPIO number"
                default 17 if IDF_TARGET_ESP32
                default 4 if IDF_TARGET_ESP32S2 || IDF_TARGET_ESP32C3
                help
                    Set the GPIO number used by the SPI Ethernet module interrupt line.
        endif # USE_SPI_ETHERNET

        config ETH_PHY_RST_GPIO
            int "PHY Reset GPIO number"
            default 16 if IDF_TARGET_ESP32
            default 5 if IDF_TARGET_ESP32S2 || IDF_TARGET_ESP32C3
            help
                Set the GPIO number used to reset PHY chip.
                Set to -1 to disable PHY chip hardware reset.

        config ETH_PHY_ADDR
            int "PHY Address"
            range 0 31
            default 1
            help
                Set PHY address according your board schematic.
    
    endmenu

    config READ_EEPROM
        bool "Read EEPROM"
        default y
        help
            Read EEPROM content via I2C and send it to update tool.

    menu "I2C Configuration"
        depends on READ_EEPROM

        config GPIO_SDA
            int "SDA"
            default 35
            help
                GPIO number for the SDA line

        config GPIO_SCL
            int "SCL"
            default 36
            help
                GPIO number for the SCL line
        
        config I2C_FREQ
            int "I2C Frequency"
            default 100000

        config EEPROM_LENGTH
            int "EEPROM Length"
            default 512
            help
                Length of the EEPROM to read in byte

    endmenu

endmenu
```

## examples/device/cdc_ecm_ota/sdkconfig.defaults
```kconfig
CONFIG_IDF_TARGET="esp32s2"
CONFIG_PARTITION_TABLE_TWO_OTA=y
CONFIG_ESPTOOLPY_FLASHSIZE_4MB=y
CONFIG_USB_ENABLED=y
CONFIG_USB_NET_ENABLED=y
CONFIG_LWIP_IPV6=n
CONFIG_FREERTOS_HZ=1000
```

## examples/device/ethernet_ota/sdkconfig.defaults
```kconfig
CONFIG_IDF_TARGET="esp32"
CONFIG_BOOTLOADER_APP_ROLLBACK_ENABLE =y
CONFIG_PARTITION_TABLE_TWO_OTA=y
CONFIG_ESPTOOLPY_FLASHSIZE_4MB=y
CONFIG_ESP_TASK_WDT_PANIC=y
CONFIG_ESP_TASK_WDT_TIMEOUT_S=20
CONFIG_ETH_ENABLED=y
CONFIG_OTA_ETHERNET=y
CONFIG_LWIP_NETIF_STATUS_CALLBACK=y
```
